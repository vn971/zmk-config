## config/west.yml
```yaml
manifest:
  remotes:
    - name: vn971
      url-base: https://github.com/vn971
    # Additional modules containing boards/shields/custom code can be listed here as well
    # See https://docs.zephyrproject.org/3.2.0/develop/west/manifest.html#projects
  projects:
    - name: zmk
      remote: vn971
      revision: main
      import: app/west.yml
  self:
    path: config
```
